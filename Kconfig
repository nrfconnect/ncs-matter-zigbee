## Kconfig
```kconfig
# Copyright (c) 2026 Nordic Semiconductor ASA
# SPDX-License-Identifier: LicenseRef-Nordic-5-Clause
#
# Kconfig entry point for the ncs-matter-zigbee add-on module.

menuconfig MATTER_ZIGBEE_ADD_ON
	bool "Enable Matter + Zigbee add-on"
	depends on ZIGBEE_ADD_ON && CHIP
	default y
	help
	  Add-on module for combined Matter and Zigbee solutions.
	  Requires both the ncs-zigbee (ZIGBEE_ADD_ON) and Matter (CHIP).

if MATTER_ZIGBEE_ADD_ON

rsource "subsys/Kconfig"

endif
```

## subsys/Kconfig
```kconfig
#
# Copyright (c) 2026 Nordic Semiconductor ASA
#
# SPDX-License-Identifier: LicenseRef-Nordic-5-Clause
#

if MATTER_ZIGBEE_ADD_ON

rsource "lib/Kconfig"


config DISABLE_DK_LEDS
	bool "Disable DK LEDs usage"
	depends on DK_LIBRARY
	help
	  Enables LEDs module to be used in the application.

endif
```

## subsys/lib/Kconfig
```kconfig
#
# Copyright (c) 2026 Nordic Semiconductor ASA
#
# SPDX-License-Identifier: LicenseRef-Nordic-5-Clause
#

rsource "matter_zigbee_coexistence/Kconfig"
rsource "matter_zigbee_protocol_state/Kconfig"
```

## subsys/lib/matter_zigbee_coexistence/Kconfig
```kconfig
#
# Copyright (c) 2026 Nordic Semiconductor ASA
#
# SPDX-License-Identifier: LicenseRef-Nordic-5-Clause
#

menuconfig MATTER_ZIGBEE_COEXISTENCE
	bool "Matter + Zigbee coexistence runtime for combined applications"
	depends on MATTER_ZIGBEE_ADD_ON
	depends on CHIP && SETTINGS && ZIGBEE_ADD_ON
	depends on BT
	depends on CHIP_LAST_FABRIC_REMOVED_ERASE_AND_REBOOT
	select MATTER_ZIGBEE_PROTOCOL_STATE
	default y
	help
	  Shared orchestration layer for samples that host both Matter and
	  Zigbee stacks on the same 802.15.4 radio. Owns the Zigbee and
	  Matter worker threads, the radio handover on first Matter
	  commissioning, and updates the persistent protocol state across
	  reboots and factory resets.

	  On last-fabric removal the device reboots and resumes the protocol
	  selected by CONFIG_MATTER_ZIGBEE_PROTOCOL_STATE_DEFAULT_PROTOCOL.

if MATTER_ZIGBEE_COEXISTENCE

config MATTER_ZIGBEE_COEXISTENCE_BT_ADV_WHILE_ZIGBEE
	bool "Allow CHIPoBLE commissioning while Zigbee is active"
	default y
	depends on CHIP_ENABLE_PAIRING_AUTOSTART
	help
	  When enabled, Matter may start BLE commissioning advertising while
	  the Zigbee stack owns the 802.15.4 radio. The Zigbee worker waits
	  for the first CHIPoBLE advertising-started event before chaining
	  sample button handlers and starting Zigbee.

	  Requires CONFIG_CHIP_ENABLE_PAIRING_AUTOSTART in the application.

	  When disabled, the sample must call
	  matter_zigbee_coexistence_signal_matter_board_init() after Matter
	  server init completes.
	  The Zigbee worker then proceeds without waiting for Thread
	  or DNS-SD. Set CONFIG_CHIP_ENABLE_PAIRING_AUTOSTART=n if Matter
	  commissioning over BLE is not needed until after a protocol switch.

config MATTER_ZIGBEE_COEXISTENCE_BUTTON_SWITCH
	bool "Enable user protocol switch on button long press"
	default y
	help
	  When enabled, samples may call
	  matter_zigbee_coexistence_process_switch_button() to switch between
	  Zigbee and Matter using a long button press.

	  When disabled, protocol changes rely on Matter commissioning events
	  and factory reset only.

config MATTER_ZIGBEE_COEXISTENCE_SWITCH_BUTTON_PRESS_TIME_SECONDS
	int "Protocol-switch button hold time (seconds)"
	depends on MATTER_ZIGBEE_COEXISTENCE_BUTTON_SWITCH
	range 1 30
	default 5
	help
	  Hold time required when pressing the protocol-switch button.
	  When the timer expires, the coexistence runtime attempts to switch
	  to the other protocol unless pairing or commissioning is in progress.

config MATTER_ZIGBEE_COEXISTENCE_DFU_SMP_BUTTON_HANDLER
	bool "Supplement Button 1 for DFU over SMP while Zigbee is active"
	default y
	depends on CHIP_DFU_OVER_BT_SMP
	help
	  Register an extra DK Button 1 handler when Matter server init
	  completes. After a protocol switch back to Zigbee, the default NCS
	  Matter board handler does not start SMP BLE advertising because
	  Thread is disabled and a stored fabric blocks commissioning
	  advertising. The supplemental handler calls DFUOverSMP::StartServer()
	  on Button 1 press when the active protocol is Zigbee and at least one
	  Matter fabric exists. Applies to combined light_switch and light_bulb
	  samples without per-sample changes.

config MATTER_ZIGBEE_COEXISTENCE_ZIGBEE_THREAD_STACK_SIZE
	int "Zigbee worker thread stack size (bytes)"
	default 2048

config MATTER_ZIGBEE_COEXISTENCE_ZIGBEE_THREAD_PRIORITY
	int "Zigbee worker thread priority"
	default 3

config MATTER_ZIGBEE_COEXISTENCE_MATTER_THREAD_STACK_SIZE
	int "Matter worker thread stack size (bytes)"
	default 3072

config MATTER_ZIGBEE_COEXISTENCE_MATTER_THREAD_PRIORITY
	int "Matter worker thread priority"
	default 3

module = MATTER_ZIGBEE_COEXISTENCE
module-str = Matter/Zigbee coexistence
source "${ZEPHYR_BASE}/subsys/logging/Kconfig.template.log_config"

endif # MATTER_ZIGBEE_COEXISTENCE
```

## subsys/lib/matter_zigbee_protocol_state/Kconfig
```kconfig
#
# Copyright (c) 2026 Nordic Semiconductor ASA
#
# SPDX-License-Identifier: LicenseRef-Nordic-5-Clause
#

menuconfig MATTER_ZIGBEE_PROTOCOL_STATE
	bool "Persistent protocol state for combined Matter + Zigbee applications"
	depends on MATTER_ZIGBEE_COEXISTENCE && SETTINGS
	default y
	help
	  Small settings-backed module that tracks which protocol (Zigbee or
	  Matter) the combined application should resume after a reboot. Used
	  by samples that host both stacks on the same 802.15.4 radio.

if MATTER_ZIGBEE_PROTOCOL_STATE

choice MATTER_ZIGBEE_PROTOCOL_STATE_DEFAULT_PROTOCOL
	prompt "Default protocol on first boot"
	default MATTER_ZIGBEE_PROTOCOL_STATE_DEFAULT_ZIGBEE
	help
	  Applied when no protocol state has been stored yet (factory-fresh
	  device), after a Matter factory reset, or after the settings entry
	  was erased. Subsequent boots use the persisted value until one of
	  those events applies the default again.

config MATTER_ZIGBEE_PROTOCOL_STATE_DEFAULT_ZIGBEE
	bool "Zigbee"
	help
	  Start on Zigbee: bring up the Zigbee stack and hand the 802.15.4
	  radio to ZBOSS unless a previous run already persisted Matter.

config MATTER_ZIGBEE_PROTOCOL_STATE_DEFAULT_MATTER
	bool "Matter"
	help
	  Start on Matter: skip Zigbee stack start and hand the 802.15.4 radio
	  to OpenThread unless a previous run already persisted Zigbee.

endchoice

module = MATTER_ZIGBEE_PROTOCOL_STATE
module-str = Matter/Zigbee protocol state
source "${ZEPHYR_BASE}/subsys/logging/Kconfig.template.log_config"

endif # MATTER_ZIGBEE_PROTOCOL_STATE
```

## subsys/lib/matter_zigbee_smp_dfu/Kconfig
```kconfig
#
# Copyright (c) 2026 Nordic Semiconductor ASA
#
# SPDX-License-Identifier: LicenseRef-Nordic-5-Clause
#

menuconfig MATTER_ZIGBEE_SMP_DFU
	bool "SMP DFU button handler for combined Matter + Zigbee samples"
	depends on MATTER_ZIGBEE_ADD_ON && CHIP_DFU_OVER_BT_SMP
	depends on NCS_SAMPLE_MATTER_CUSTOM_BLUETOOTH_ADVERTISING
	default n
	help
	  Deprecated: SMP DFU is handled by the common UI module when
	  CONFIG_MATTER_ZIGBEE_UI_SMP_DFU is enabled. This standalone option
	  registers a separate chained button handler and should not be used
	  together with matter_zigbee_ui.

if MATTER_ZIGBEE_SMP_DFU

module = MATTER_ZIGBEE_SMP_DFU
module-str = Matter/Zigbee SMP DFU
source "${ZEPHYR_BASE}/subsys/logging/Kconfig.template.log_config"

endif # MATTER_ZIGBEE_SMP_DFU
```

## subsys/lib/matter_zigbee_ui/Kconfig
```kconfig
#
# Copyright (c) 2026 Nordic Semiconductor ASA
#
# SPDX-License-Identifier: LicenseRef-Nordic-5-Clause
#

menuconfig MATTER_ZIGBEE_UI
	bool "Common Matter + Zigbee UI for combined samples"
	depends on MATTER_ZIGBEE_COEXISTENCE
	depends on DK_LIBRARY
	default y
	help
	  Shared button and LED handling for combined Matter + Zigbee samples.
	  Samples register optional callbacks from main() and pass
	  matter_zigbee_ui_register() as the coexistence post_matter_ui_init hook.
	  That hook calls dk_buttons_init() for the common UI dispatcher.

if MATTER_ZIGBEE_UI

config MATTER_ZIGBEE_UI_FACTORY_RESET_PRESS_TIME_SECONDS
	int "Matter factory reset button press time (seconds)"
	default 5
	range 2 30
	help
	  Total time budget for the Matter factory-reset button gesture on
	  MATTER_ZIGBEE_UI_BUTTON_FACTORY_RESET. Half of this value is the
	  initial hold before the cancel window opens; the other half is the
	  cancel window duration (keeping the button pressed through it confirms
	  the reset).

module = MATTER_ZIGBEE_UI
module-str = Matter/Zigbee UI
source "${ZEPHYR_BASE}/subsys/logging/Kconfig.template.log_config"

endif # MATTER_ZIGBEE_UI
```
